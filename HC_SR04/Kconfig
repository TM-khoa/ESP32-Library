## HC_SR04/Kconfig
```kconfig
menu "Custom Ultrasonic HC_SR04 Setting"
	config GPIO_RANGE_MAX
		int "Target GPIO Num"
		default 33 if IDF_TARGET_ESP32
		default 46 if IDF_TARGET_ESP32S2
		default 19 if IDF_TARGET_ESP32C3
		default 48 if IDF_TARGET_ESP32S3
		
	config HC_SR04_TRIGGER_GPIO
		int "HC_SR04 TRIGGER GPIO number"
		range 0 GPIO_RANGE_MAX
		default 22 if IDF_TARGET_ESP32
		default 12 if IDF_TARGET_ESP32S2 || IDF_TARGET_ESP32S3
		default  6 if IDF_TARGET_ESP32C3
		help
			config GPIO number (IOxx) to TRIGGER.
			Some GPIOs are used for other purposes (flash connections, etc.) and cannot be used to ADC.

	config HC_SR04_ECHO_GPIO
		int "HC_SR04 ECHO GPIO number"
		range 0 GPIO_RANGE_MAX
		default 21 if IDF_TARGET_ESP32
		default 11 if IDF_TARGET_ESP32S2 || IDF_TARGET_ESP32S3
		default  5 if IDF_TARGET_ESP32C3
		help
			config GPIO number (IOxx) to ECHO.
			Some GPIOs are used for other purposes (flash connections, etc.) and cannot be used to ADC.
endmenu
```

## LCD_I2C/Kconfig
```kconfig
menu "Custom LCD I2C mapping"
config LCD_RS_PIN
    int "LCD RS pin"
    default 0
    range 0 7
config LCD_E_PIN    
    int "LCD E pin"
    default 1
    range 0 7
config LCD_BACKLIGHT_PIN    
    int "LCD BACKLIGHT pin"
    default 2
    range 0 7
config LCD_D4_PIN  
    int "LCD D4 pin"  
    default 3
    range 0 7
config LCD_D5_PIN
    int "LCD D5 pin"    
    default 4
    range 0 7
config LCD_D6_PIN 
    int "LCD D6 pin"   
    default 5
    range 0 7
config LCD_D7_PIN    
    int "LCD D7 pin"
    default 6
    range 0 7
config COLLUNMS    
    int "LCD num of columns"
    default 16
    range 0 100
config ROWS    
    int "LCD num of rows"
    default 2
    range 0 4
endmenu
```

## PWM/Kconfig
```kconfig
menu "Custom PWM Setting"
	config GPIO_RANGE_MAX
		int "Target GPIO Num"
		default 33 if IDF_TARGET_ESP32
		default 46 if IDF_TARGET_ESP32S2
		default 19 if IDF_TARGET_ESP32C3
		default 48 if IDF_TARGET_ESP32S3

	config PWM_GPIO
		int "PWM_GPIO number"
		range 0 GPIO_RANGE_MAX
		default 22 if IDF_TARGET_ESP32
		default 12 if IDF_TARGET_ESP32S2 || IDF_TARGET_ESP32S3
		default  6 if IDF_TARGET_ESP32C3

	config PWM_FREQ
		int "Frequency in Hz from 100Hz to 10MHz"
		range 100 1000000
		default 100000

	config PWM_PERIOD
		int "PWM period"
		default 0
endmenu
```
